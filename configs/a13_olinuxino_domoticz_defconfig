## configs/a13_olinuxino_domoticz_defconfig
```kconfig
BR2_arm=y
BR2_cortex_a8=y
BR2_GCC_VERSION_4_5_X=y
BR2_TOOLCHAIN_BUILDROOT_LARGEFILE=y
BR2_TOOLCHAIN_BUILDROOT_INET_IPV6=y
BR2_TOOLCHAIN_BUILDROOT_WCHAR=y
BR2_TOOLCHAIN_BUILDROOT_CXX=y
BR2_TARGET_GENERIC_ROOT_PASSWD="root1*"
BR2_ROOTFS_POST_BUILD_SCRIPT="board/a13_olinuxino/post-build.sh"
BR2_ROOTFS_POST_IMAGE_SCRIPT="board/a13_olinuxino/post-image.sh"
BR2_PACKAGE_BUSYBOX_SHOW_OTHERS=y
BR2_PACKAGE_DIRECTFB=y
BR2_PACKAGE_PICOLISP=y
BR2_PACKAGE_SQLITE=y
BR2_PACKAGE_NCURSES=y
BR2_PACKAGE_DOMOTICZ=y
BR2_PACKAGE_DHCP=y
BR2_PACKAGE_DHCP_SERVER=y
BR2_PACKAGE_DHCP_RELAY=y
BR2_PACKAGE_DHCP_CLIENT=y
BR2_PACKAGE_DROPBEAR=y
BR2_PACKAGE_WIRELESS_TOOLS=y
BR2_PACKAGE_WIRELESS_TOOLS_LIB=y
BR2_PACKAGE_WPA_SUPPLICANT=y
BR2_PACKAGE_WPA_SUPPLICANT_EAP=y
BR2_PACKAGE_WPA_SUPPLICANT_CLI=y
BR2_PACKAGE_WPA_SUPPLICANT_PASSPHRASE=y
BR2_PACKAGE_WPA_SUPPLICANT_AP_SUPPORT=y
BR2_PACKAGE_WPA_SUPPLICANT_WPS=y
BR2_PACKAGE_MODULE_INIT_TOOLS=y
BR2_PACKAGE_UTIL_LINUX=y
BR2_PACKAGE_UTIL_LINUX_LIBUUID=y
BR2_PACKAGE_A13_OLINUXINO_SOFTWARE=y
BR2_PACKAGE_A13_OLINUXINO_SOFTWARE_MOD_RTC=y
BR2_PACKAGE_A13_OLINUXINO_SOFTWARE_MOD_TC_MK2=y
BR2_PACKAGE_HOST_SUNXI_TOOLS=y
BR2_PACKAGE_SUNXI_TOOLS_FEXFILE="board/a13_olinuxino/olinuxino_full_gpios.fex"
BR2_TARGET_UBOOT_SUNXI=y
BR2_TARGET_UBOOT_SUNXI_BOARDNAME="A13-OLinuXino"
BR2_TARGET_UBOOT_SUNXI_GITHUB_LOCATION="https://github.com/linux-sunxi/u-boot-sunxi"
BR2_TARGET_UBOOT_SUNXI_GITHUB_TAG="3f5ff92"
BR2_TARGET_UBOOT_SUNXI_SPL=y
BR2_LINUX_KERNEL=y
BR2_LINUX_KERNEL_CUSTOM_GIT=y
BR2_LINUX_KERNEL_CUSTOM_GIT_REPO_URL="https://github.com/linux-sunxi/linux-sunxi.git"
BR2_LINUX_KERNEL_USE_CUSTOM_CONFIG=y
BR2_LINUX_KERNEL_CUSTOM_CONFIG_FILE="board/a13_olinuxino/kernel.config"
BR2_LINUX_KERNEL_INSTALL_TARGET=y
```

## package/domoticz/Config.in
```kconfig
config BR2_PACKAGE_DOMOTICZ
	bool "domoticz"
    select BR2_PACKAGE_LIBCURL
    select BR2_PACKAGE_BOOST
    select BR2_PACKAGE_BOOST_THREAD
    select BR2_PACKAGE_BOOST_SYSTEM
    select BR2_PACKAGE_BOOST_DATE_TIME
    select BR2_PACKAGE_BOOST_CHRONO
    select BR2_PACKAGE_OPENSSL
    select BR2_PACKAGE_LIGHTTPD
    select BR2_PACKAGE_LIGHTTPD_OPENSSL
    select BR2_PACKAGE_LIGHTTPD_LUA
    select BR2_PACKAGE_LIGHTTPD_ZLIB
    select BR2_PACKAGE_SQLITE
	help
	    TODO
```

## package/sunxi-tools/Config.in.host
```kconfig
config BR2_PACKAGE_HOST_SUNXI_TOOLS
    depends on BR2_cortex_a8
	bool "host sunxi-tools"
	help
	  Sunxi-tools is the host side implementation providing fex2bin and 
	  bin2fex binaries.

if BR2_PACKAGE_HOST_SUNXI_TOOLS
config BR2_PACKAGE_HOST_SUNXI_TOOLS_GITHUB_LOCATION
    string "Link to github of Sunxi-tools"
    default "https://github.com/linux-sunxi/sunxi-tools"

config BR2_PACKAGE_SUNXI_TOOLS_FEXFILE
    string "Fexfile"
    default "board/a13_olinuxino/olinuxino_LCD_800x480.fex"

endif #  BR2_PACKAGE_HOST_SUNXI_TOOLS
```
